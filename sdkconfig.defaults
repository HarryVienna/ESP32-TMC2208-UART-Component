## sdkconfig.defaults
```kconfig
#
# FreeRTOS
#
#CONFIG_FREERTOS_HZ=100

#
# ESP32-specific
#
CONFIG_ESP32_RTC_CLK_SRC_INT_8MD256=y
CONFIG_ESP32_DEFAULT_CPU_FREQ_240=y
CONFIG_ESP32_DEFAULT_CPU_FREQ_MHZ=240

CONFIG_LOG_DEFAULT_LEVEL_DEBUG=y
CONFIG_LOG_DEFAULT_LEVEL=4

CONFIG_ESP_TASK_WDT=n
```
